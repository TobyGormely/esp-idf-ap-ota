## components/apUpdate/Kconfig.projbuild
```kconfig
menu "AP OTA Update Config"
    config HOSTNAME_SET
        string "Webpage Host Name"
        default "simpleota"
    config SSID_SET
        string "AP SSID"
        default "Simple OTA"
    config PASSWORD_SET
        string "AP Password"
        default "simpleota"
endmenu
```

## components/simpleOTA/Kconfig.projbuild
```kconfig
menu "Simple OTA Configuration"

    menu  "Simple OTA Settings"
    config SIMPLE_OTA_AP_SSID
        string "Access Point SSID"
        default "Simple OTA"
        help
            The WiFi network name that will be created for OTA updates.
            Users connect to this network to upload firmware.

    config SIMPLE_OTA_AP_PASSWORD
        string "Access Point Password"
        default "simpleota"
        help
            Password for the OTA access point. Must be at least 8 characters
            for WPA2 security, or leave empty for open network (not recommended).
            
            If password is 1-7 characters, it will be ignored and an open 
            network will be created instead, as WPA2 requires minimum 8 characters.

    config SIMPLE_OTA_HOSTNAME
        string "mDNS Hostname"
        default "simple-ota"
        help
            Hostname for mDNS service. Device will be accessible at
            http://hostname.local (e.g., http://simple-ota.local)

    config SIMPLE_OTA_TIMEOUT_MINUTES
        int "Auto-shutdown timeout (minutes)"
        default 0
        range 0 1440
        help
            Automatically shut down OTA after this many minutes of inactivity.
            Set to 0 to disable timeout. Maximum 24 hours (1440 minutes).

    config SIMPLE_OTA_AUTO_REBOOT
        bool "Auto-reboot after successful update"
        default y
        help
            Automatically reboot the device after a successful firmware update.
            Disable this if you need to perform cleanup before rebooting.

    config SIMPLE_OTA_MAX_FILE_SIZE_MB
        int "Maximum firmware file size (MB)"
        default 2
        range 1 16
        help
            Maximum size of firmware files that can be uploaded.
            Larger files will be rejected to prevent memory issues.
    endmenu 

    menu "Web Page Customisation"
    config SIMPLE_OTA_WEB_PAGE_TITLE
        string "Web Page Title"
        default "Simple OTA"
        help
            Title for the web page served by the OTA access point.

    config SIMPLE_OTA_WEB_PAGE_FOOTER
        string "Web Page Footer"
        default "Created By Toby Gormely"
        help
            Footer text for the web page served by the OTA access point.

    config SIMPLE_OTA_WEB_PAGE_PRIMARY_COLOUR
        hex "Web Page Primary Colour"
        default 0x17243f
        help
            Primary colour for the web page (in hex, e.g., 0x17243f for dark blue).
            Used for headers and buttons.

    config SIMPLE_OTA_WEB_PAGE_SECONDARY_COLOUR
        hex "Web Page Secondary Colour"
        default 0x6c757d
        help
            Secondary colour for the web page (in hex, e.g., 0x6c757d for grey).
            Used for borders and dividers.

    config SIMPLE_OTA_WEB_PAGE_BACKGROUND_COLOUR
        hex "Web Page Background Colour"
        default 0xf8f9fa
        help
            Background colour for the web page (in hex, e.g., 0xf8f9fa for light grey).
    endmenu

endmenu
```

## sdkconfig.defaults
```kconfig
CONFIG_FATFS_VFS_FSTAT_BLKSIZE=4096

# WiFi Configuration
CONFIG_LWIP_NETIF_HOSTNAME_ENABLE=y

# OTA Configuration  
CONFIG_BOOTLOADER_APP_ROLLBACK_ENABLE=y
CONFIG_PARTITION_TABLE_CUSTOM_FILENAME="partitions.csv"
CONFIG_PARTITION_TABLE_FILENAME="partitions.csv"

# HTTP Server
CONFIG_HTTPD_MAX_REQ_HDR_LEN=1024
CONFIG_HTTPD_MAX_URI_LEN=512
```
